## Documentation/devicetree/bindings/char/qcom,fastrpc.txt
```
Qualcomm Technologies, Inc. FastRPC Driver

The FastRPC driver implements an IPC (Inter-Processor Communication)
mechanism that allows for clients to transparently make remote method
invocations across DSP and APPS boundaries. This enables developers
to offload tasks to the DSP and free up the application processor for
other tasks.

- compatible:
	Usage: required
	Value type: <stringlist>
	Definition: must be "qcom,fastrpc"

- reg
	Usage: required
	Value type: <u32>
	Definition: DSP Processor ID.
	Possible values are :
			0 - ADSP
			1 - MDSP
			2 - SDSP
			3 - CDSP

= COMPUTE BANKS
Each subnode of the Fastrpc node represents compute context banks avaiable
on the dsp. The name of the nodes are not important. The properties of these
nodes are defined by the individual bindings for the specific service
- All Compute context banks MUST contain the following property:

- compatible:
	Usage: required
	Value type: <stringlist>
	Definition: must be "qcom,fastrpc-compute-cb"

Example:

fastrpc {
	compatible = "qcom,fastrpc";
	qcom,smd-channels = "fastrpcsmd-apps-dsp";
	reg = <0>; /* DOMAIN_ADSP */

	compute_cb1 {
		compatible = "qcom,fastrpc-compute-cb";
		iommus = <&lpass_q6_smmu 8>;
	};

	compute_cb2 {
		compatible = "qcom,fastrpc-compute-cb";
		iommus = <&lpass_q6_smmu 9>;
	};
	...
};
```

## Documentation/devicetree/bindings/dma/qcom-gpi.yaml
```yaml
# SPDX-License-Identifier: GPL-2.0
%YAML 1.2
---
$id: http://devicetree.org/schemas/dma/gpi-dma.yaml#
$schema: http://devicetree.org/meta-schemas/core.yaml#

title: Qualcomm Technologies Inc GPI DMA controller

description: |
  QCOM GPI DMA controller provides DMA capabilities for
  peripheral buses such as I2C, UART, and SPI.

maintainers:
  - Vinod Koul <vkoul@kernel.org>

allOf:
  - $ref: "dma-controller.yaml#"

properties:
  compatible:
    enum:
      - qcom,gpi-dma

  reg:
    maxItems: 1

  interrupts:
    description:
      Interrupt lines for each GPII instance
    maxItems: 14

  qcom,max-num-gpii:
    description:
      Maximum number of GPII instances available
    maxItems: 1

  "#dma-cells":
    const: 1

  qcom,gpii-mask:
    description:
      Bitmap of supported GPII instances for OS
    maxItems: 1

  qcom,ev-factor:
    description:
      Event ring transfer size compare to channel transfer ring. Event
        ring length = ev-factor * transfer ring size
    maxItems: 1

required:
  - compatible
  - reg
  - interrupts
  - qcom,max-num-gpii
  - qcom,gpii-mask
  - qcom,ev-factor
  - "#dma-cells"

unevaluatedProperties: false

examples:
  - |
    #include <dt-bindings/interrupt-controller/arm-gic.h>
    gpi_dma0: dma@800000 {
        #dma-cells = <5>;
        compatible = "qcom,gpi-dma";
        reg = <0 0x00800000 0 0x60000>;
        qcom,max-num-gpii = <13>;
        qcom,gpii-mask = <0xfa>;
        qcom,ev-factor = <2>;
        interrupts = <GIC_SPI 244 IRQ_TYPE_LEVEL_HIGH>,
                     <GIC_SPI 245 IRQ_TYPE_LEVEL_HIGH>,
                     <GIC_SPI 246 IRQ_TYPE_LEVEL_HIGH>,
                     <GIC_SPI 247 IRQ_TYPE_LEVEL_HIGH>,
                     <GIC_SPI 248 IRQ_TYPE_LEVEL_HIGH>,
                     <GIC_SPI 249 IRQ_TYPE_LEVEL_HIGH>,
                     <GIC_SPI 250 IRQ_TYPE_LEVEL_HIGH>,
                     <GIC_SPI 251 IRQ_TYPE_LEVEL_HIGH>,
                     <GIC_SPI 252 IRQ_TYPE_LEVEL_HIGH>,
                     <GIC_SPI 253 IRQ_TYPE_LEVEL_HIGH>,
                     <GIC_SPI 254 IRQ_TYPE_LEVEL_HIGH>,
                     <GIC_SPI 255 IRQ_TYPE_LEVEL_HIGH>,
                     <GIC_SPI 256 IRQ_TYPE_LEVEL_HIGH>;
    };

...
```

## Documentation/devicetree/bindings/interconnect/qcom,msm8916.txt
```
Qualcomm MSM8916 Network-On-Chip interconnect driver binding
------------------------------------------------------------

Required properties :
- compatible : shall contain only one of the following:
			"qcom,msm8916-bimc"
			"qcom,msm8916-pcnoc"
			"qcom,msm8916-snoc"
- #interconnect-cells : should contain 1

reg : specifies the physical base address and size of registers
clocks : list of phandles and specifiers to all interconnect bus clocks
clock-names : clock names should include both "bus" and "bus_a"

Example:

		bimc: interconnect@400000 {
			compatible = "qcom,msm8916-bimc";
			reg = <0x00400000 0x62000>;
			#interconnect-cells = <1>;
			clock-names = "bus", "bus_a";
			clocks = <&rpmcc RPM_SMD_BIMC_CLK>,
				 <&rpmcc RPM_SMD_BIMC_A_CLK>;
		};

		pcnoc: interconnect@500000 {
			compatible = "qcom,msm8916-pcnoc";
			reg = <0x00500000 0x11000>;
			#interconnect-cells = <1>;
			clock-names = "bus", "bus_a";
			clocks = <&rpmcc RPM_SMD_PCNOC_CLK>,
				 <&rpmcc RPM_SMD_PCNOC_A_CLK>;
		};

		snoc: interconnect@580000 {
			compatible = "qcom,msm8916-snoc";
			reg = <0x00580000 0x14000>;
			#interconnect-cells = <1>;
			clock-names = "bus", "bus_a";
			clocks = <&rpmcc RPM_SMD_SNOC_CLK>,
				 <&rpmcc RPM_SMD_SNOC_A_CLK>;
		};
```

## Documentation/devicetree/bindings/misc/qcom,fastrpc.txt
```
Qualcomm Technologies, Inc. FastRPC Driver

The FastRPC driver implements an IPC (Inter-Processor Communication)
mechanism that allows for clients to transparently make remote method
invocations across DSP and APPS boundaries. This enables developers
to offload tasks to the DSP and free up the application processor for
other tasks.

- compatible:
	Usage: required
	Value type: <stringlist>
	Definition: must be "qcom,fastrpc"

- label
	Usage: required
	Value type: <string>
	Definition: should specify the dsp domain name this fastrpc
	corresponds to. must be one of this: "adsp", "mdsp", "sdsp", "cdsp"

- #address-cells
	Usage: required
	Value type: <u32>
	Definition: Must be 1

- #size-cells
	Usage: required
	Value type: <u32>
	Definition: Must be 0

= COMPUTE BANKS
Each subnode of the Fastrpc node represents compute context banks available
on the dsp. The name of the nodes are not important. The properties of these
nodes are defined by the individual bindings for the specific service
- All Compute context banks MUST contain the following property:

- compatible:
	Usage: required
	Value type: <stringlist>
	Definition: must be "qcom,fastrpc-compute-cb"

- reg
	Usage: required
	Value type: <u32>
	Definition: Context Bank ID.

- secured:
	Usage: Optional
	Value type: <boolean>
	Defination: Indicating context bank is secured

- nsessions:
	Usage: Optional
	Value type: <u32>
	Defination: A value indicating how many sessions can share this
		    context bank. Defaults to 1 when this property
		    is not specified.

Example:

adsp-pil {
	compatible = "qcom,msm8996-adsp-pil";
	...
	smd-edge {
		label = "lpass";
		fastrpc {
			compatible = "qcom,fastrpc";
			qcom,smd-channels = "fastrpcsmd-apps-dsp";
			lable = "adsp";
			#address-cells = <1>;
			#size-cells = <0>;

			cb@1 {
				compatible = "qcom,fastrpc-compute-cb";
				reg = <1>;
			};

			cb@2 {
				compatible = "qcom,fastrpc-compute-cb";
				reg = <2>;
			};
			...
		};
	};
};
```
