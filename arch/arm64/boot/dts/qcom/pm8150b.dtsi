// SPDX-License-Identifier: BSD-3-Clause
// Copyright (c) 2017-2019, The Linux Foundation. All rights reserved.
// Copyright (c) 2019, Linaro Limited

#include <dt-bindings/interrupt-controller/irq.h>
#include <dt-bindings/spmi/spmi.h>

&spmi_bus {
	pm8150@2 {
		compatible = "qcom,spmi-pmic";
		reg = <0x2 SPMI_USID>;
		#address-cells = <1>;
		#size-cells = <0>;
	};

	qcom,pm8150@3 {
		compatible ="qcom,spmi-pmic";
		reg = <0x3 SPMI_USID>;
		#address-cells = <1>;
		#size-cells = <0>;
	};
};
